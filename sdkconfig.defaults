## sdkconfig.defaults
```kconfig
#
# Partition Table
#
CONFIG_PARTITION_TABLE_CUSTOM=y
CONFIG_PARTITION_TABLE_CUSTOM_FILENAME="partitions_example.csv"
CONFIG_PARTITION_TABLE_FILENAME="partitions_example.csv"
CONFIG_PARTITION_TABLE_CUSTOM_APP_BIN_OFFSET=0x10000
CONFIG_APP_OFFSET=0x10000

#
# ESP32-specific
#
CONFIG_ESP32_PANIC_PRINT_HALT=y
CONFIG_ESP32_DEFAULT_CPU_FREQ_240=y

#
# FreeRTOS
#
CONFIG_FREERTOS_HZ=1000
CONFIG_MAIN_TASK_STACK_SIZE=8192
CONFIG_TASK_WDT_TIMEOUT_S=20

#
# Serial flasher config
#
CONFIG_ESPTOOLPY_FLASHSIZE_4MB=y
CONFIG_ESPTOOLPY_FLASHSIZE="4MB"

#
# TFT Display - default is WROVER 4.1 DevKit
#
#CONFIG_TFT_PREDEFINED_DISPLAY_TYPE=4
#CONFIG_TFT_PREDEFINED_DISPLAY_TYPE4=y
```
